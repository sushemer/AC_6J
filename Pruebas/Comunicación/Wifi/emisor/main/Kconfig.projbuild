## Pruebas/Comunicación/Wifi/emisor/main/Kconfig.projbuild
```kconfig
menu "WiFi sender"
    config WIFI_SSID
        string "WiFi SSID"
        default ""
    config WIFI_PASSWORD
        string "WiFi password"
        default ""
    config TCP_SERVER_IP
        string "Receiver IPv4 address"
        default "192.168.0.223"
    config TCP_PORT
        int "TCP receiver port"
        default 3333
    config SEND_INTERVAL_MS
        int "Message interval (ms)"
        default 1000
endmenu
```

## Pruebas/Comunicación/Wifi/receptor/main/Kconfig.projbuild
```kconfig
menu "WiFi receiver"
    config WIFI_SSID
        string "WiFi SSID"
        default ""
    config WIFI_PASSWORD
        string "WiFi password"
        default ""
    config WIFI_MAX_RETRY
        int "Maximum WiFi retries"
        default 10
    config TCP_PORT
        int "TCP listening port"
        default 3333
endmenu
```
